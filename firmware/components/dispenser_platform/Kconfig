## firmware/components/dispenser_platform/Kconfig
```kconfig
menu "Dispenser V2 platform"

config DSP_SNTP_SERVER
    string "SNTP server"
    default "pool.ntp.org"
    help
        NTP server used for time synchronization (UTC). One server; the
        domain decides whether a received time is accepted.

config DSP_NOTIFY_URL
    string "Notification endpoint (HTTPS)"
    default "https://dispenser-notify.nowassek.workers.dev/api/v1/events"
    help
        Protocol-v1 ingestion endpoint (cloudflare/dispenser-notify). Must start
        with https://. Not a secret; the device token lives only in the
        "nvs_sec" partition. Automated tests never use this URL.

config DSP_NOTIFY_HEALTH_URL
    string "Backend health URL (diagnostic TLS probe)"
    default "https://dispenser-notify.nowassek.workers.dev/health"
    help
        Unauthenticated GET used only by the off-by-default HTTPS diagnostic to
        verify Wi-Fi, trusted time and certificate validation without sending
        an event or a credential.

config DSP_BUTTON_WAKE_GPIO
    int "Button deep-sleep wake GPIO (-1 = none)"
    range -1 21
    default -1
    help
        GPIO of the service-mode wake button. -1 (the default image) keeps the
        button wake disabled. The MVP wake button (sdkconfig.button.defaults)
        uses XIAO ESP32-C3 D1 = GPIO3: a normally-open momentary pushbutton to
        GND with an external 10 kOhm pull-up to 3V3, active low, not connected
        to RESET or BOOT. Only the ESP32-C3 deep-sleep wake pads GPIO0-GPIO5
        are accepted and the strapping pin GPIO2 is refused (build-time check,
        repeated at run time). Configures an input only, never an output.

        A button wake (ESP_SLEEP_WAKEUP_GPIO) opens the BLE service window like
        a power-on in the bring-up build; a timer wake never does. The button
        is never a dosing trigger. The wake is level triggered on the ESP32-C3:
        when the button is still active at sleep entry, only the timer is armed
        and the sleep is capped to 60 s (no wake loop).

config DSP_BUTTON_WAKE_ACTIVE_HIGH
    bool "Button wake level is high"
    default n
    help
        Wake on a high level (default: low level with a pull-up, as in the MVP
        button circuit).

config DSP_BATTERY_ADC_GPIO
    int "Battery voltage ADC GPIO (-1 = none)"
    range -1 21
    default -1
    help
        ADC pad of the battery voltage divider. -1 (the default image) means no
        battery telemetry: GET_BATTERY answers NOT_MEASURED. The MVP circuit
        (sdkconfig.battery.defaults) uses XIAO ESP32-C3 D2 = GPIO4 (ADC1_CH4):
        BAT+ -> 1 MOhm -> GPIO4 -> 1 MOhm -> GND, optionally 100 nF from GPIO4
        to GND. Only ADC1 pads GPIO0-GPIO4 are accepted (ADC2 is not usable
        with the radio); the strapping pin GPIO2, the wake button and the pump
        pin are refused at build time. Measured once per wake before any
        dosing, Wi-Fi or BLE, and on request (GET_BATTERY) at most once per
        minute, never right after a pump run. Runtime only: nothing is stored.

config DSP_BATTERY_DIVIDER_X1000
    int "Battery divider ratio x1000 (battery voltage / pad voltage)"
    range 1000 10000
    default 2000
    depends on DSP_BATTERY_ADC_GPIO >= 0
    help
        (R1 + R2) / R2 x 1000. 2000 for two equal resistors (1 MOhm / 1 MOhm).
        May be trimmed after a comparison with a multimeter at BAT+.

config DSP_BATTERY_LOW_MV
    int "BATTERY_LOW notification: episode opens below (measured mV)"
    range 2500 4500
    default 3900
    depends on DSP_BATTERY_ADC_GPIO >= 0
    help
        Measured battery voltage (as reported by the firmware, not the app's
        percentage) below which a BATTERY_LOW notification episode opens,
        confirmed by a second measurement in the same wake. Default 3900 mV:
        conservative for the temporary 5 V relay module powered from the 1S
        cell (a 5 V coil typically needs >= 3.75 V to pull in, plus sag while
        the motor starts). BENCH PROPOSAL: validate the relay pull-in voltage.

config DSP_BATTERY_RECOVER_MV
    int "BATTERY_LOW notification: episode closes at or above (measured mV)"
    range 2600 4600
    default 4050
    depends on DSP_BATTERY_ADC_GPIO >= 0
    help
        Hysteresis: an open BATTERY_LOW episode ends only when the measured
        voltage reaches this value (confirmed by a second measurement), which
        in practice needs a charge. Must be greater than DSP_BATTERY_LOW_MV
        (build-time check).

config DSP_OTA
    bool "Firmware update over the air (owner-initiated, GitHub Releases)"
    default n
    depends on DSP_APP_CONNECTIVITY && DSP_BLE_SECURITY
    help
        GET_UPDATE_STATUS / START_UPDATE (docs/BLE_PROTOCOL.md 10.8,
        docs/FIRMWARE_UPDATE.md). Needs a rollback-capable bootloader
        (CONFIG_BOOTLOADER_APP_ROLLBACK_ENABLE) and signed applications
        (CONFIG_SECURE_SIGNED_APPS_NO_SECURE_BOOT with
        CONFIG_SECURE_SIGNED_ON_UPDATE_NO_SECURE_BOOT); checked at build time.

config DSP_OTA_RELEASE_BASE
    string "Release asset base URL"
    default "https://github.com/Nowass/dispenser/releases/download/"
    depends on DSP_OTA
    help
        https://github.com/<owner>/<repo>/releases/download/ (checked at build
        time and again at run time). The device appends
        <tag>/dispenser-firmware-<version>.bin; the phone never sends a URL.

config DSP_OTA_TEST_FAIL_BOOT_CHECK
    bool "TEST ONLY: the boot check of this image always fails (rollback test)"
    default n
    depends on DSP_OTA
    help
        An image built with this option asks the bootloader to roll back at
        the end of its first wake. Only for the documented rollback test.

endmenu
```
