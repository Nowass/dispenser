## firmware/main/Kconfig.projbuild
```kconfig
menu "Dispenser V2"

config DSP_STORAGE_SMOKE_TEST
    bool "Read-only persistent storage check at boot (diagnostic)"
    default n
    help
        Opens the NVS namespace read-only and runs the storage layout check
        (dsp_storage_open without provisioning), then logs the result.
        The check itself never writes dispenser keys and never requests an
        erase. Note: the NVS initialization it relies on
        (nvs_flash_init_partition, ESP-IDF) may write to flash internally,
        e.g. initialize blank pages, finish or revert an interrupted NVS
        operation, or erase and rewrite pages during its recovery; this
        option cannot prevent that. Off by default; no dosing or hardware
        activity.

config DSP_TIME_SYNC_DIAGNOSTIC
    bool "Time-management diagnostic at boot (no Wi-Fi without credentials)"
    default n
    help
        Evaluates clock trust from the reset reason and the RTC-retained marker,
        then runs one forced time-sync session with the "no credentials"
        provider. Because Wi-Fi credentials are not provisioned yet (BLE
        provisioning is a later milestone), Wi-Fi is never started and no
        network activity happens; the session reports "credentials
        unavailable". Does not read or write NVS, dose or touch GPIO.
        Purpose: build/link verification of the Wi-Fi, SNTP and clock
        adapters. Off by default.

config DSP_NOTIFY_HTTPS_DIAGNOSTIC
    bool "HTTPS notification transport diagnostic at boot (no event unless the option below)"
    default n
    help
        Reads the developer-provisioned "nvs_sec" partition (read-only), runs one
        forced time-sync session with those Wi-Fi credentials and, only with a
        trusted clock, one unauthenticated TLS GET of DSP_NOTIFY_HEALTH_URL
        (full certificate bundle, date checks on). Logs only outcomes: never
        credentials, SSIDs or tokens. Never posts a notification, never writes
        the dispenser NVS namespace, never doses. Without provisioned
        credentials the radio is never started. Off by default.

config DSP_NOTIFY_HTTPS_DIAGNOSTIC_BATTERY_EVENT
    bool "...and send ONE BATTERY_LOW test event (writes the endpoint's D1, sends an e-mail)"
    default n
    depends on DSP_NOTIFY_HTTPS_DIAGNOSTIC && DSP_BATTERY_ADC_GPIO >= 0
    help
        Hardware end-to-end check of ESP32-C3 -> Wi-Fi -> TLS -> Worker -> D1 -> e-mail
        for BATTERY_LOW. Measures the battery once (before the radio starts); only with
        a VALID voltage, a trusted clock and a provisioned token it POSTs one protocol-v1
        BATTERY_LOW event (value = the measured mV, value2 = 0) to DSP_NOTIFY_URL through
        the production HTTPS transport, then repeats the identical event (same ID,
        attempt 2) to prove idempotency (expected 201, then 200 duplicate). The event
        uses a separate diagnostic storage epoch (0xD1A6xxxx, random low half), so its ID
        never collides with the device's real notification queue. Nothing is stored on
        the device; the dispenser NVS namespace, the pump GPIO and dosing are untouched.
        DSP_NOTIFY_URL defaults to PRODUCTION: building this option is an explicit
        decision to write one event to that D1 and send one e-mail. Off by default.

config DSP_APP_RUNTIME
    bool "Application cycle with SIMULATED pump and deep sleep (M1.9c, opt-in)"
    default n
    depends on !DSP_STORAGE_SMOKE_TEST && !DSP_TIME_SYNC_DIAGNOSTIC && !DSP_NOTIFY_HTTPS_DIAGNOSTIC
    help
        Runs the M1.9b application cycle (dsp_app_run_wake) in a dedicated
        static task: SAFE_OFF first, storage in the "nvs" partition
        (provisions on first boot: SERVICE_REQUIRED, no limits), recovery,
        dosing through the Dosing Service, planning, shutdown checklist and
        deep sleep. The pump is a SIMULATION (no GPIO, nothing actuated) and
        the simulated hardware runtime maximum defaults to 0, so no dose can
        start. No BLE (service mode unavailable). Not verified on hardware.
        Off by default: the default image keeps the M0.2 behavior.

config DSP_APP_CONNECTIVITY
    bool "Enable Wi-Fi time sync and notification delivery in the application cycle"
    default n
    depends on DSP_APP_RUNTIME
    help
        Uses the developer-provisioned "nvs_sec" credentials and the endpoint
        DSP_APP_NOTIFY_URL, which must be set explicitly (the build fails
        otherwise; there is no fallback to the production endpoint). Without
        credentials the radio is never started. Automated tests never run
        firmware. Off by default.

config DSP_APP_WIFI_TIME
    bool "Wi-Fi time synchronization only (no HTTPS, no notifications; bench)"
    default n
    depends on DSP_APP_RUNTIME && !DSP_APP_CONNECTIVITY
    help
        The application cycle synchronizes the clock over Wi-Fi/SNTP (bounded attempts,
        bounded SNTP timeout, the M1.4 interval and backoff, Wi-Fi off before BLE and deep
        sleep) using the developer-provisioned "nvs_sec" Wi-Fi credentials. No HTTP client,
        no notification delivery, no endpoint and no API token use: the notification queue
        is never delivered from. Mutually exclusive with DSP_APP_CONNECTIVITY (which adds
        HTTPS notifications and needs DSP_APP_NOTIFY_URL). Without valid credentials the
        radio is never started. Off by default.

config DSP_APP_NOTIFY_URL
    string "Application runtime notification endpoint (required, https://)"
    default ""
    depends on DSP_APP_CONNECTIVITY
    help
        Protocol-v1 ingestion endpoint used by the application runtime, e.g. an
        approved staging Worker. Must be set explicitly; the build fails when
        it is empty or not an https:// URL. The production endpoint is refused
        at build time unless DSP_APP_ALLOW_PRODUCTION is also set. Independent
        of DSP_NOTIFY_URL (M1.7 diagnostic).

config DSP_APP_ALLOW_PRODUCTION
    bool "Allow the application runtime to use the PRODUCTION endpoint"
    default n
    depends on DSP_APP_CONNECTIVITY
    help
        Separate explicit approval for DSP_APP_NOTIFY_URL pointing to the
        production Worker. Leave off during hardware bring-up.

config DSP_BLE_SECURITY
    bool "Link the BLE security layer (BUILD-ONLY until M1.10c.2b hardware acceptance)"
    default n
    depends on DSP_APP_RUNTIME
    help
        Registers the Noise security session (dispenser_security) and the ESP32-C3
        RNG adapter with the application runtime. Without a BLE transport (M1.10d)
        nothing is reachable; this exists for cross-builds and resource measurement.
        The target RNG path has NOT been validated on hardware (M1.10c.2b, design
        6.1): the build refuses this option together with the production endpoint.

config DSP_BLE_TRANSPORT
    bool "NimBLE BLE transport (BUILD-ONLY until M1.10c.2b and M1.10d.2 hardware acceptance)"
    default n
    depends on DSP_BLE_SECURITY && BT_NIMBLE_ENABLED
    help
        Connects the Application Service's BLE port to NimBLE (dispenser_platform
        dsp_ble_transport + dsp_esp_ble): advertising, GATT service, fragmentation,
        notifications. The service window still opens only on a presence wake.
        The NimBLE settings come from sdkconfig.ble.defaults. Not validated on
        hardware: the build refuses this option together with the production
        endpoint, and security-enabled firmware must not be deployed before the
        ESP32-C3 RNG hardware gate (M1.10c.2b) passes.

config DSP_BLE_BRINGUP_POWER_ON_WINDOW
    bool "Bring-up only: a power-on wake opens a service window (never production)"
    default n
    depends on DSP_BLE_TRANSPORT
    help
        Hardware acceptance (M1.10d.2) without the button driver (M10): a power
        cycle counts as physical presence like a button wake. Authentication,
        the entropy-source prerequisite and every authorization rule are
        unchanged; deterministic randomness is never used. Refused together with
        the production endpoint.

config DSP_PUMP_GPIO
    bool "BENCH: drive a GPIO as the pump control signal (no load connected)"
    default n
    depends on DSP_APP_RUNTIME
    help
        Replaces the simulated pump with a GPIO control signal driven by the Dosing Service:
        active for the calculated runtime of a dose that passed every gate and limit, then
        inactive (pad readback, independent esp_timer cutoff at runtime + 100 ms, deep-sleep hold
        of the inactive level). Bench stage: no pump, MOSFET or other load is connected; nothing
        measures liquid. The driver circuit must keep the gate inactive by itself whenever the
        pad is not driven (reset, boot, after a wake): see firmware/README.md. Refused together
        with the production endpoint. Off by default.

config DSP_PUMP_GPIO_NUM
    int "Pump control GPIO (XIAO ESP32-C3 D10 = GPIO10)"
    range 0 21
    default 10
    depends on DSP_PUMP_GPIO
    help
        Allowed: 0, 1, 3-7, 10. Never a strapping pin (2, 8, 9), the SPI flash pins (11-17),
        USB (18, 19) or UART0 (20, 21); checked at build time.

config DSP_PUMP_GPIO_ACTIVE_HIGH
    bool "Pump control signal is active high"
    default y
    depends on DSP_PUMP_GPIO
    help
        Active high fits a low-side N-channel MOSFET with a gate pull-down: an undriven pad (reset,
        boot, deep sleep without hold) then reads inactive.

config DSP_PUMP_GPIO_MAX_RUNTIME_MS
    int "Pump control signal: maximum active time per run (ms)"
    range 1 60000
    default 10000
    depends on DSP_PUMP_GPIO
    help
        The hardware runtime maximum of this build: pump configuration with a larger
        max_runtime_ms is refused (PUMP_CONFIG gate) and the driver refuses longer runs. The
        independent cutoff fires at runtime + 100 ms.

config DSP_APP_SIM_HW_MAX_RUNTIME_MS
    int "Simulated pump hardware runtime maximum (ms, 0 = never actuate)"
    range 0 60000
    default 0
    depends on DSP_APP_RUNTIME && !DSP_PUMP_GPIO
    help
        Stands in for the hardware cutoff of the future pump driver. 0 (the
        default) closes every dose in the Dosing Service. Even a non-zero
        value only drives the simulated pump, never a GPIO.

config DSP_APP_MAX_SLEEP_S
    int "Maximum sleep / re-evaluation interval (s)"
    range 60 86400
    default 21600
    depends on DSP_APP_RUNTIME

config DSP_APP_TASK_STACK
    int "Application task stack (bytes)"
    range 6144 32768
    default 12288
    depends on DSP_APP_RUNTIME
    help
        Static stack of the single application task (measured worst-case
        call-chain frame sum plus margin; see firmware/README.md).

config DSP_RNG_GATE_DIAGNOSTIC
    bool "RNG-gate diagnostic image (M1.10c.2b evidence R1-R3, R5, R6; no BLE host)"
    default n
    depends on BT_ENABLED && BT_CONTROLLER_ONLY && !DSP_APP_RUNTIME && !DSP_BLE_SECURITY && !DSP_BLE_TRANSPORT && !DSP_APP_CONNECTIVITY && !DSP_STORAGE_SMOKE_TEST && !DSP_TIME_SYNC_DIAGNOSTIC && !DSP_NOTIFY_HTTPS_DIAGNOSTIC
    help
        Separate diagnostic image (sdkconfig.rnggate.defaults; design
        docs/ANDROID_BLE_DESIGN.md Appendix B). Once per boot it registers the
        libsodium RNG adapter (R1), checks that the adapter refuses while the
        Bluetooth controller is off (R3), enables the BT controller alone (no
        host stack: no GATT, no advertising, scanning or connections) so that
        the RF entropy source is active, checks the adapter routing (R2),
        streams DSP_RNG_GATE_SAMPLE_BYTES from esp_fill_random and the same
        amount through libsodium randombytes_buf as framed Base64 lines with
        CRC-32 over the console (R5, captured by tools/rng_capture.py),
        optionally derives the public PSK vectors (R6), disables the
        controller again (R3) and then idles. No Noise service, no NVS
        access (PHY calibration storage must be off), no credentials, no
        eFuse writes, no GPIO output. Refused together with the production
        endpoint. Not validated on hardware.

config DSP_RNG_GATE_SAMPLE_BYTES
    int "RNG-gate sample size per source (bytes)"
    range 4096 8388608
    default 1048576
    depends on DSP_RNG_GATE_DIAGNOSTIC
    help
        Bytes streamed from each source (esp_fill_random, then libsodium
        randombytes_buf) in 4096-byte blocks; the last block may be shorter.
        Default 1 MiB (the R5 minimum), at most 8 MiB. At the default 115200
        baud UART console 1 MiB per source takes about 2 minutes.

config DSP_RNG_GATE_PSK_VECTORS
    bool "RNG-gate: derive the PSK vectors of ble_session_v1.txt on the device (R6)"
    default n
    depends on DSP_RNG_GATE_DIAGNOSTIC
    help
        Embeds the public "psk" and "psk_not" records of
        test-vectors/ble_session_v1.txt (CMake-generated header) and derives
        each through dsp_psk_derive (mbedTLS / TF-PSA-Crypto PSA HKDF). Logs
        pass/fail counts only, never key bytes. Links only dsp_secderive.c and
        dsp_hkdf_psa.c of dispenser_security (no Noise, no dsp_blesec).

endmenu
```
